/**************************************************************************************
            ___  _   _______ _                     _     _       ______              _ 
           / _ \| | | | ___ \ |                   (_)   | |      |  ___|            (_)
          / /_\ \ | | | |_/ / | ____ _ _ __   ___  _  __| |______| |_ __ _ _ __ ___  _ 
          |  _  | | | |    /| |/ / _` | '_ \ / _ \| |/ _` |______|  _/ _` | '_ ` _ \| |
          | | | \ \_/ / |\ \|   < (_| | | | | (_) | | (_| |      | || (_| | | | | | | |
          \_| |_/\___/\_| \_|_|\_\__,_|_| |_|\___/|_|\__,_|      \_| \__,_|_| |_| |_|_|
                                                                                       
          DIY Arkanoid "Vaus" paddle clone for Famicom and compatibles
          based on Digispark ATtiny85 development board
          KKusz 2024 https://kusz.me https://github.com/kkusz/avrkanoid-fami

          Original work by Danjovic 2020
          https://github.com/Danjovic/MSX/blob/master/DigiArka

**************************************************************************************/

#include <avr/sleep.h>
#include <avr/interrupt.h>
#include <avr/power.h>
#include <avr/pgmspace.h>

// Lookup table for non-linearity compensation of "linear" potentiometer
const uint16_t Knob_Map[1024] PROGMEM = {
    312, 312, 312, 312, 312, 312, 312, 312, 312, 312, 312, 312, 312, 312, 312, 312, 312, 312, 312,
    312, 312, 312, 312, 312, 312, 312, 312, 312, 312, 312, 312, 312, 312, 312, 312, 312, 312, 312,
    312, 312, 312, 312, 312, 312, 312, 312, 312, 312, 312, 312, 312, 312, 312, 312, 312, 312, 312,
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    1021, 1021, 1021, 1022, 1022, 2022, 1023, 1023, 1023
};

// output serial knob data
#define DIGI_OUT_P0 0

// input start ADC
#define DIGI_IN_P1  1

// input read knob data
#define DIGI_IN_P2  2

#define MSBIT 8

// uncomment to use LUT for linearity compensation
// #define USE_LUT

volatile uint8_t Input_ADC;
volatile uint16_t Knob_Raw_Input;
volatile uint16_t Shift_Register;
volatile uint8_t Timer_Count = 0;

void setup() {
  init_adc();
  timer_setup();

  cli();

  GIMSK |= (1 << INT0) |
           (1 << PCIE);
  MCUCR =  (0 << ISC00) | // External INT on Falling edge ISC=[10])
           (1 << ISC01); // on pin TRGA (clock)
  PCMSK = (0 << PCINT0) | //
          (1 << PCINT1) | // Pin change INT on PULSE pin
          (0 << PCINT2) | //
          (0 << PCINT3) | //
          (0 << PCINT4) | //
          (0 << PCINT5); //

  // clear any pending interrupts
  GIFR =  (1 << INTF0) |
          (1 << PCIF );

  analogReference(DEFAULT);
  pinMode(DIGI_IN_P1,  INPUT_PULLUP);
  pinMode(DIGI_IN_P2,  INPUT_PULLUP);
  pinMode(DIGI_OUT_P0, OUTPUT);

  sei();
}

void init_adc() {

  ADMUX  = (1 << MUX0 ) | // Select AN3 ADMUX=[0011]
           (1 << MUX1 ) | //
           (0 << MUX2 ) | //
           (0 << MUX3 ) | //
           (0 << REFS2) | //
           (0 << ADLAR) | // Right Aligned value 
           (0 << REFS0) | //
           (0 << REFS1);  // Select Vref=Vcc REFS=[000]

  ADCSRA = (0 << ADPS0) | // Prescaler 16 ADPS=[100]
           (0 << ADPS1) | //
           (1 << ADPS2) | //
           (0 << ADIE ) | // No ADC interrupts
           (0 << ADIF ) | //
           (1 << ADATE) | // Enable Auto Trigger
           (1 << ADSC ) | // Start conversion
           (1 << ADEN );  // Enable ADC

  ADCSRB = (0 << ADTS0) | // Free running mode ADTS=[000]
           (0 << ADTS1) | //
           (0 << ADTS2) | //
           (0 << IPR  ) | //
           (0 << ACME ) | //
           (0 << BIN  );  //
}

void timer_setup()
{
  TCCR0A=0x00;                     // normal mode
  TCCR0B=0x00;
  TCCR0B |= (1<<CS00) | (1<<CS01); // prescaling with 64
  TCNT0=0;
  TIMSK|=(1<<TOIE0);               // enabling timer0 interrupt
  PORTB|=(1<<PB1);
}

void loop() {
   go_sleep();
}

// override Arduino's main function to be able to install custom timer0 interrupt
int main() {
  setup();
  while (true) loop();
}

inline void go_sleep() {
  set_sleep_mode(SLEEP_MODE_IDLE);
  sleep_enable();
  sleep_mode();
  sleep_disable();
}

// /OE received from console, shift one bit
ISR(INT0_vect)
{
    if (Shift_Register & (1 << MSBIT)) {
      pinMode(DIGI_OUT_P0, INPUT_PULLUP);
    } else {
      digitalWrite(DIGI_OUT_P0, LOW);
      pinMode(DIGI_OUT_P0, OUTPUT);
    }
    Shift_Register <<= 1;
    GIFR |= (1 << PCIF);
}

// Start_ADC received from console, wait 3ms and continue in timer0 interrupt handler
// to prevent updating knob position prematurely before console finishes reading previous data
// from shift register
ISR(PCINT0_vect)
{
      Timer_Count = 0;
}

// Interrupt vector for Timer0
// whole operation (including ADC reading) should take around 7 ms
ISR (TIMER0_OVF_vect)
{
  if (Timer_Count>0) // waiting for 3ms
  {
    if (Timer_Count == 1) {
      while (!(ADCSRA & (1 << ADIF)) );
      Knob_Raw_Input = ADC ^ 0x3FF;      // depending on how you wire your potentiometer
      // Knob_Raw_Input = ADC            // you may or may not want to flip bits coming from ADC
                                         // to adjust paddle direction
      ADCSRA |= (1 << ADIF);

#ifdef USE_LUT
      Shift_Register = pgm_read_word(Knob_Map + Knob_Raw_Input) >> 1;
#else
      Shift_Register = Knob_Raw_Input >> 1;
#endif

      if (Shift_Register & (1 << MSBIT)) {
        pinMode(DIGI_OUT_P0, INPUT_PULLUP);
      } else {
        digitalWrite(DIGI_OUT_P0, LOW);
        pinMode(DIGI_OUT_P0, OUTPUT);
      }
      Shift_Register <<= 1;
      Timer_Count++;
    }
  }
  else  Timer_Count++;
}
